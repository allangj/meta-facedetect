## conf/layer.conf
```bitbake
# We have a conf and classes directory, append to BBPATH
BBPATH .= ":${LAYERDIR}"

# We have a recipes directory, add to BBFILES
BBFILES += "${LAYERDIR}/recipes*/*/*.bb ${LAYERDIR}/recipes*/*/*.bbappend"

BBFILE_COLLECTIONS += "meta-facedetect"
BBFILE_PATTERN_meta-facedetect := "^${LAYERDIR}/"
BBFILE_PRIORITY_meta-facedetect = "6"
```
